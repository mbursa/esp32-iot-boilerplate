## src/Kconfig.projbuild
```kconfig
menu "Application Configuration"

    config APP_WIFI_SSID
        string "WiFi SSID name"
        help
            Defines the name of WiFi network to connect to

    config APP_WIFI_PASSWORD
        string "WiFi password"
        help
            Defines a password for the WiFi connection

    config APP_WIFI_RECONNECT_INTERVAL
        int "WiFi reconnect intervals (s)"
        default 15
        help
            Defines an interval in seconds for reconnect attempts 

    config APP_MDNS_HOSTNAME
        string "mDNS hostname"
        help
            Defines the hostname in the mDNS system

    config APP_MDNS_DESCRIPTION
        string "mDNS friendly name"
        help
            Defines a friendly name in the mDNS system
endmenu
```
